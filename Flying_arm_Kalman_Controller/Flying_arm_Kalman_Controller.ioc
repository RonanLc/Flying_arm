# file: Flying_arm_Kalman_Controller.ioc
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Mcu.Family=STM32F4
Mcu.Name=STM32F407V(E-G)Tx
Mcu.Package=LQFP100
NVIC.PriorityGroup=NVIC_PRIORITYGROUP_4
ProjectManager.HeapSize=0x200
ProjectManager.StackSize=0x400
ProjectManager.TargetToolchain=STM32CubeIDE
RCC.AHBFreq_Value=16000000
RCC.APB1Freq_Value=16000000
RCC.APB2Freq_Value=16000000
RCC.CortexFreq_Value=16000000
RCC.HSE_VALUE=25000000
RCC.HSI_VALUE=16000000
RCC.LSE_VALUE=32768
RCC.SYSCLKFreq_VALUE=16000000
RCC.VCOOutputFreq_Value=192000000
STMicroelectronics.X-CUBE-ALGOBUILD.1.4.0.LibraryCcDSPOoLibraryJjDSPOoLibrary=true
VP_STMicroelectronics.X-CUBE-ALGOBUILD_VS_DSPOoLibraryJjLibrary_1.4.0_1.4.0.Mode=DSPOoLibraryJjLibrary
board=custom

// file: Core/Src/main.c
/* USER CODE BEGIN Header */
/**
  ******************************************************************************
  * @file           : main.c
  * @brief          : Main program body
  ******************************************************************************
  * @attention
  *
  * Copyright (c) 2024 STMicroelectronics.
  * All rights reserved.
  *
  * This software is licensed under terms that can be found in the LICENSE file
  * in the root directory of this software component.
  * If no LICENSE file comes with this software, it is provided AS-IS.
  *
  ******************************************************************************
  */

/* USER CODE END Header */
#include "main.h"

/* USER CODE BEGIN PV */
// Fixed-loop sampling time
const double Ts 				= 0.01;   //[s]

// Dynamic model parameters
const float Inertia_Jz 			= 0.0576; //[m/kg]
const float mass_arm_prop 		= 0.240;  //[kg]
const float distOG 				= 0.38;   //[m]
const float gravity 			= 9.81;   //[m/s2]
const float L					= 0.65;   //[m]
const float fr					= 0.1;    //[N.m/s]

// Sensors containers and target
double theta_target 			= M_PI / 2; //[rad]
double theta 					= 0;      	//[rad]
double theta_dot				= 0;      	//[rad/s]

double PWM_ctrl					= T_pwm_offset;

// Corrector output container
double thrust					= 0; 	  //[N]

// Screen menu status
ConsigneType	Consigne_type;
ControllerType	Controller_type;
FilterType		Filter_type;

/* USER CODE END PV */

/* USER CODE BEGIN PFP */

double map(double val, double min_in, double max_in, double min_out, double max_out);

/* USER CODE END PFP */

int main(void)
{

  /* MCU Configuration--------------------------------------------------------*/

  /* Reset of all peripherals, Initializes the Flash interface and the Systick. */
  HAL_Init();

  /* Configure the system clock */
  //SystemClock_Config();
  Clock_init();

  /* Initialize all configured peripherals */
  /* USER CODE BEGIN 2 */

  Motor_init();
  Filter_init(Ts);
  Hmi_init();

  // Lcd begining

  HAL_Delay(100);

  /* USER CODE END 2 */

  /* Infinite loop */
  while (1)
  {

    /* USER CODE BEGIN 3 */

	  Motor_SetTime(PWM_ctrl);

	  Controller_type = Hmi_get_controller_name();
	  Filter_type = Hmi_get_filter_name();
	  Consigne_type = Hmi_get_consigne_name();

	  Filter_refresh(Filter_type, thrust);

	  theta = Filter_GetAngle();
	  theta_dot = Filter_GetGyro();

	  theta_target = Setpoint_GetTarget(Consigne_type, theta_target);

	  thrust = Control_refresh(Controller_type, theta_target, theta, theta_dot);

	  PWM_ctrl = thrust_to_PWM(thrust);

	  // Create a fixed-loop execution //
	  Wait_Until(Ts * 1000);

  }
  /* USER CODE END 3 */
}

/* USER CODE BEGIN 4 */

double map(double val, double min_in, double max_in, double min_out, double max_out){
	 return (val - min_in) * (max_out - min_out) / (max_in - min_in) + min_out;
}

/* USER CODE END 4 */

void Error_Handler(void)
{
  __disable_irq();
  while (1)
  {
  }
}
